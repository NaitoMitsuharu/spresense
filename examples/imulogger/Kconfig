## examples/imulogger/Kconfig
```kconfig
config EXAMPLES_IMULOGGER
	tristate "imulogger command enabled"
	default y
	---help---
		Enable the imulogger app

if EXAMPLES_IMULOGGER

config EXAMPLES_IMULOGGER_PROGNAME
	string "Program name"
	default "imulogger"
	---help---
		This is the name of the program that will be use when the NSH ELF
		program is installed.

config EXAMPLES_IMULOGGER_PRIORITY
	int "imulogger task priority"
	default 100

config EXAMPLES_IMULOGGER_STACKSIZE
	int "imulogger stack size"
	default 2048

endif
```

## examples/lsboard/Kconfig
```kconfig
config EXAMPLES_LSBOARD
	tristate "lsboard command enable"
	default y
	---help---
    Enable the lsboard command that lists connected boards and sensors in JSON format

if EXAMPLES_LSBOARD

config EXAMPLES_LSBOARD_PROGNAME
	string "Program name"
	default "lsboard"
	---help---
		This is the name of the program that will be use when the NSH ELF
		program is installed.

config EXAMPLES_LSBOARD_PRIORITY
	int "lsboard task priority"
	default 100

config EXAMPLES_LSBOARD_STACKSIZE
	int "lsboard stack size"
	default 2048

endif
```
